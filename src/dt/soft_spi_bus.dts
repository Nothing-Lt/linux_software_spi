/dts-v1/;
/plugin/;

/{
    compatible = "ti,beaglebone", "ti,beaglebone-black";
    part-number = "BBB-I2C2"; // you can choose any name here but it should be memorable
    version = "00A0";

    fragment@0{
        target-path = "/";
        __overlay__{
            soft_spi_bus{
                compatible = "soft_spi_bus";
                sck_pin = <66>;
                miso_pin = <68>;
                mosi_pin = <69>;
            };
        };
    };
};
